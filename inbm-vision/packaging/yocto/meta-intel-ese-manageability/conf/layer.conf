## inbm-vision/packaging/yocto/meta-intel-ese-manageability/conf/layer.conf
```bitbake
# We have a conf and classes directory, add to BBPATH
BBPATH .= ":${LAYERDIR}"

# We have recipes-* directories, add to BBFILES
BBFILES += "${LAYERDIR}/recipes-*/*/*.bb \
            ${LAYERDIR}/recipes-*/*/*.bbappend"

BBFILE_COLLECTIONS += "manageability"
BBFILE_PATTERN_manageability = "^${LAYERDIR}/"
BBFILE_PRIORITY_manageability = "10"
LAYERVERSION_manageability = "1"

LAYERSERIES_COMPAT_manageability = "sumo rocko thud warrior zeus dunfell hardknott"
```
